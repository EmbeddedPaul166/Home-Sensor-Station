## main/Kconfig.projbuild
```kconfig
menu "Configuration"

    menu "AM2320-I2C"

        config I2C_MASTER_SCL
            int "Master SCL GPIO Number"
            default 22
            help
                GPIO number for I2C clock line.

        config I2C_MASTER_SDA
            int "Master SDA GPIO Number"
            default 21
            help
                GPIO number for I2C data line.

        config I2C_MASTER_PORT_NUMBER
            int "Port Number"
            default 1
            help
                Port number for I2C Master device.

        config I2C_MASTER_FREQUENCY_IN_HZ
            int "Master Frequency"
            default 100000
            help
                I2C Speed of device.

        config I2C_MASTER_RX_BUFFER_DISABLE
            int "Disable Master RX buffer"
            default 0
            help
                I2C disable Master RX buffer.

        config I2C_MASTER_TX_BUFFER_DISABLE
            int "Disable Master TX buffer"
            default 0
            help
                I2C disable Master TX buffer.

        config I2C_AM2320_SENSOR_ADDRESS
            hex "AM2320 I2C address"
            default 0x5c
            help
                I2C AM2320 address.

    endmenu

    menu "MQ5"
    
        config MQ5_DIGITAL_PIN
            int "MQ5 digital pin"
            default 26
            help
                MQ5 digital pin.
        
        config MQ5_ANALOG_PIN
            int "MQ5 analog pin"
            default 27
            help
                MQ5 analog pin.
    
    endmenu

    menu "PIR"
    
        config PIR_DIGITAL_PIN
            int "PIR digital pin"
            default 32
            help
                PIR digital pin.
        
    endmenu
    
    menu "Wi-Fi"
    
        config ESP_WIFI_SSID
            string "WiFi SSID"
            default "ASUS"
            help
                SSID (network name) to connect to.

        config ESP_WIFI_PASSWORD
            string "WiFi Password"
            default "0666066606660"
            help
                WiFi password (WPA or WPA2) to use.

        config ESP_WIFI_MAXIMUM_RETRY
            int "Maximum retry"
            default 10
            help
                Set the Maximum retry to avoid station reconnecting to the AP unlimited when the AP is really inexistent.
    
    endmenu

endmenu
```
